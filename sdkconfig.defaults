## sdkconfig.defaults
```kconfig
# Rust often needs a bit of an extra main task stack size compared to C (the default is 3K)
CONFIG_ESP_MAIN_TASK_STACK_SIZE=8000

# stop on panic
CONFIG_ESP_SYSTEM_PANIC_PRINT_HALT=y

# enable large header fields like: "Mozilla/5.0 (X11; U; Linux i686; en-US; rv:1.9.0.4) Gecko/20100101 Firefox/4.0"
CONFIG_HTTPD_MAX_REQ_HDR_LEN=1024
```
